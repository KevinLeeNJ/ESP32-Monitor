## firmware/components/firmware/Kconfig
```kconfig
menu "ESP32 Monitor"

config MONITOR_PM_PROFILE
    bool "Enable KEY-triggered PM profiling"
    default n
    depends on PM_ENABLE
    select PM_PROFILING
    help
        Build the five-minute PM capture task and persisted report support.
        Hold KEY alone for three seconds to capture or print a saved report.
        Leave disabled for production firmware.

endmenu
```

## firmware/sdkconfig.defaults
```kconfig
CONFIG_IDF_TARGET="esp32s3"
CONFIG_ESPTOOLPY_FLASHMODE_QIO=y
CONFIG_ESPTOOLPY_FLASHSIZE_16MB=y
CONFIG_PARTITION_TABLE_CUSTOM=y
CONFIG_PARTITION_TABLE_CUSTOM_FILENAME="partitions.csv"
CONFIG_SPIRAM=y
CONFIG_SPIRAM_MODE_OCT=y
CONFIG_SPIRAM_SPEED_80M=y
CONFIG_PM_ENABLE=y
# CONFIG_MONITOR_PM_PROFILE is not set
# CONFIG_PM_PROFILING is not set
CONFIG_FREERTOS_USE_TICKLESS_IDLE=y
CONFIG_ESP_PHY_MAC_BB_PD=y
CONFIG_USJ_NO_AUTO_LS_ON_CONNECTION=y
# Button level interrupts are masked from the shared IRAM GPIO ISR.
CONFIG_GPIO_CTRL_FUNC_IN_IRAM=y
CONFIG_ESP_DEFAULT_CPU_FREQ_MHZ_240=y
CONFIG_ESP32S3_INSTRUCTION_CACHE_32KB=y
# Keep internal RAM available for concurrent weather/Devices TLS handshakes.
CONFIG_ESP32S3_DATA_CACHE_32KB=y
CONFIG_ESP32S3_DATA_CACHE_LINE_64B=y
CONFIG_SPIRAM_XIP_FROM_PSRAM=y
CONFIG_FREERTOS_HZ=1000
CONFIG_ESP_TASK_WDT_EN=y
CONFIG_ESP_TASK_WDT_INIT=y
CONFIG_ESP_TASK_WDT_PANIC=y
CONFIG_ESP_TASK_WDT_TIMEOUT_S=5
CONFIG_ESP_TASK_WDT_CHECK_IDLE_TASK_CPU0=y
CONFIG_ESP_TASK_WDT_CHECK_IDLE_TASK_CPU1=y
CONFIG_ESP_SYSTEM_PANIC_PRINT_REBOOT=y
CONFIG_ESP_MAIN_TASK_STACK_SIZE=8192
CONFIG_COMPILER_OPTIMIZATION_PERF=y

CONFIG_LWIP_SNTP_MAX_SERVERS=3

# LVGL options from the upstream LVGL Kconfig.
CONFIG_LV_CONF_SKIP=n
CONFIG_LV_COLOR_DEPTH_1=y
CONFIG_LV_OS_FREERTOS=y
CONFIG_LV_USE_CLIB_MALLOC=y
CONFIG_LV_USE_CLIB_STRING=y
CONFIG_LV_USE_CLIB_SPRINTF=y
CONFIG_LV_OBJ_STYLE_CACHE=y
```

## firmware/tests/sdkconfig.defaults
```kconfig
CONFIG_ESPTOOLPY_FLASHSIZE_16MB=y
CONFIG_ESP_MAIN_TASK_STACK_SIZE=16384
CONFIG_PARTITION_TABLE_CUSTOM_FILENAME="../partitions.csv"
```
